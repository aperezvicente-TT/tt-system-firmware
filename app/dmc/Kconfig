## app/dmc/Kconfig
```kconfig
# Copyright (c) 2025 Tenstorrent AI ULC
# SPDX-License-Identifier: Apache-2.0

config DMC_RUN_SMBUS_TESTS
	bool "Run SMBUS Tests"
	help
	  Run SMBUS tests on the DMC at boot time. This can be used to verify
	  functionality of the SMBUS interface.

config TT_QSFP
	bool "QSFP-DD cage management"
	depends on I2C
	help
	  At DMC boot, enable FXMA2102 U1 (MCU_CONN_I2C_EN) and probe the four
	  QSFP-DD cage TCA9554A expanders (0x38..0x3b) on MCU_I2C0 / i2c3 for
	  module presence. Publish TAG_QSFP_STATUS and provide serialized runtime
	  CMIS inventory, power, reset, DOM, and diagnostic page access through
	  the SMC management bridge.

config TT_QSFP_DISCOVERY
	bool
	select TT_QSFP
	help
	  Deprecated compatibility symbol. Use CONFIG_TT_QSFP.

source "Kconfig.zephyr"
```
